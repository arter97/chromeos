## Documentation/devicetree/bindings/iio/light/ap3223.txt
```
* Dyna Image AP3223 ambient light sensor and proximity sensor

http://www.dyna-image.com/english/product/optical-sensor-detail.php?cpid=2&dpid=8

Required properties:

  - compatible : should be "dynaimage,ap3223"
  - reg : the I2C address of the sensor
  - int-gpio = interrupt-specifier for the sole interrupt
		generated by the device

Example:

ap3223@1c {
	compatible = "dynaimage,ap3223";
	reg = <0x1c>;

	pinctrl-0 = <&ap3223_pins>;
	pinctrl-names = "default";

	int-gpio = <&qcom_pinmux 22 1>;
};
```

## Documentation/devicetree/bindings/video/backlight/ti,lp8557-jdi.txt
```
TI LP8557 Backlight Driver for JDI panels

Required properties:
- reg: 7-bit i2c address
- brightness-mode: Choose how brightness is controlled
	- 0: PWM brightness mode
	- 1: Brightness register mode
	- 2: PWM x unshaped brightness register mode
	- 3: Unshaped PWM x brightness register mode
- step-ramp: Ramp time for 0% to 100% change
	- 0: 0 ms
	- 1: 50 ms
	- 2: 100 ms
	- 3: 200 ms
- step-smoothing: Strength of smoothing filter
	- 0: No smoothing
	- 1: Light smoothing
	- 2: Medium smoothing
	- 3: Heavy smoothing

Optional properties:
- pwm-standby: Enable PWM standby mode after 52ms of PWM pin low
- current: Full-scale current (use R_iset resistor if property is absent)
	- 0: 5 mA
	- 1: 10 mA
	- 2: 13 mA
	- 3: 15 mA
	- 4: 18 mA
	- 5: 20 mA
	- 6: 23 mA
	- 7: 25 mA
- pwm-frequency: PWM output freq (use R_fset resistor if property is absent)
	- 0: 4.9 kHz
	- 1: 9.8 kHz
	- 2: 14.6 kHz
	- 3: 19.5 kHz
	- 4: 24.4 kHz
	- 5: 29.3 kHz
	- 6: 34.2 kHz
	- 7: 39.1 kHz
- boost-frequency: Boost freq (use R_fset resistor if property is absent)
	- 0: 500 kHz
	- 1: 1 MHz
- boost-bcomp: Boost compensation (use R_iset resistor if property is absent)
	- Option 0
	- Option 1
- led-enable:  Array of 6 elements, each represents if the corresponding LED
		string should be enabled (use auto-detect if property is absent)

Example:
		lp8557-backlight@2c {
			compatible = "ti,lp8557-jdi";
			reg = <0x2c>;

			brightness-mode = <0x0>;
			pwm-standby;
			current = <5>;
			pwm-frequency = <1>;
			boost-frequency = <1>;
			boost-bcomp = <1>;
			led-enable = <1 1 1 1 1 1>;
			step-ramp = <0>;
			step-smoothing = <0>;
		};
```

## drivers/base/test/Kconfig
```kconfig
config TEST_ASYNC_DRIVER_PROBE
	tristate "Build kernel module to test asynchronous driver probing"
	depends on m
	help
	  Enabling this option produces a kernel module that allows
	  testing asynchronous driver probing by the device core.
	  The module name will be test_async_driver_probe.ko

	  If unsure say N.

config TEST_ASYNC_FW_LOAD
	tristate "Build kernel module to test asynchronous firmware loading"
	depends on m
	help
	  Enabling this options produces a kernel module that can test
	  asynchronous firmware loading by the device core. The module name
	  will be test_async_fw_load.ko.

	  If unsure say N.
```

## drivers/media/platform/soc_camera/tegra_camera/Kconfig
```kconfig
choice
	prompt "Tegra soc_camera host driver"
	optional
	default TEGRA_VI2
	help
	   This option allows the selection of the camera implementation
	   for Tegra

config VIDEO_TEGRA_VI2
	tristate "Tegra soc_camera host VI2 driver"
	depends on VIDEO_DEV && ARCH_TEGRA && SOC_CAMERA && HAS_DMA && HAVE_CLK
	select VIDEOBUF2_DMA_CONTIG
	---help---
	  This is the v4l2 driver for the VI2-style Tegra camera interface

endchoice
```
